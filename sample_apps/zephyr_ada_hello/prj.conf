## CMakeLists.txt
```
# SPDX-License-Identifier: Apache-2.0

cmake_minimum_required(VERSION 3.20.0)

find_package(Zephyr REQUIRED HINTS $ENV{ZEPHYR_BASE})
project(zephyr_ada_hello_world)

target_sources(app PRIVATE src/main.c)

target_link_libraries(app PRIVATE libada_app)
add_subdirectory(ada_app)
```

## prj.conf
```kconfig
CONFIG_ASSERT=y
CONFIG_HW_STACK_PROTECTION=y
CONFIG_SCHED_CPU_MASK=y
CONFIG_BOOT_BANNER=y
CONFIG_PRINTK=y

# Logging configuration:
CONFIG_LOG=y
#CONFIG_LOG_BACKEND_UART=y   # this is redundant with CONFIG_SHELL_BACKEND_SERIAL and CONFIG_PRINTK
CONFIG_LOG_CMDS=y
#CONFIG_LOG_DEFAULT_LEVEL=4  # this makes zephyr crash on a data abort
#CONFIG_LOG_DEFAULT_LEVEL=3  # this is the default
#CONFIG_LOG_MAX_LEVEL=4	     # this is the default (LOG_DBGs compiled-in)
#CONFIG_LOG_MAX_LEVEL=3      # this is the default
CONFIG_LOG_MODE_IMMEDIATE=y  # without this command-line does not work correctly
#CONFIG_LOG_MODE_DEFERRED=y  # with this command-line does not work correctly
CONFIG_LOG_SPEED=y
CONFIG_LOG_SIMPLE_MSG_OPTIMIZE=y

# Console configuration:
CONFIG_CONSOLE=y
CONFIG_EARLY_CONSOLE=y
CONFIG_UART_CONSOLE=y

# Debugging configuration:
CONFIG_DEBUG_COREDUMP=y
CONFIG_DEBUG_COREDUMP_BACKEND_LOGGING=y
CONFIG_DEBUG_INFO=y
CONFIG_EXCEPTION_STACK_TRACE=y
CONFIG_EXCEPTION_DEBUG=y
CONFIG_EXTRA_EXCEPTION_INFO=y
#CONFIG_GDBSTUB=y
#CONFIG_GDBSTUB_SERIAL_BACKEND=y

CONFIG_INIT_STACKS=y
CONFIG_THREAD_STACK_INFO=y
CONFIG_THREAD_MONITOR=y
CONFIG_THREAD_NAME=y
CONFIG_POSIX_API=y
#CONFIG_POSIX_AEP_CHOICE_PSE51=y
#CONFIG_POSIX_FD_MGMT=y
#CONFIG_POSIX_MESSAGE_PASSING=y
#CONFIG_POSIX_NETWORKING=y
CONFIG_DYNAMIC_THREAD=y
CONFIG_DYNAMIC_THREAD_POOL_SIZE=3
CONFIG_NUM_PREEMPT_PRIORITIES=32
#CONFIG_POSIX_THREAD_THREADS_MAX=3


# Stats configuration:
CONFIG_STATS=y
CONFIG_THREAD_RUNTIME_STATS=y
CONFIG_THREAD_RUNTIME_STATS_USE_TIMING_FUNCTIONS=y
```

## rpi_4b.overlay
```dts
&sram0 {
    reg = <0x100000 0x80000>;
};
```

## src/main.c
```c
/* main.c - Synchronization demo */

/*
 * Copyright (c) 2012-2014 Wind River Systems, Inc.
 *
 * SPDX-License-Identifier: Apache-2.0
 */

#include "ada_app.h"
#include <zephyr/kernel.h>
#include <zephyr/sys/printk.h>

int main(void)
{
	printk(CONFIG_BOARD_TARGET " firmware (built on " __DATE__ " " __TIME__ ")\n");

  ada_appinit();

  for (int i = 0; i < 8; i++) {
    hello_ada();
  }

	return 0;
}
```
