/*
 * SPDX-License-Identifier: Apache-2.0
 *
 * Custom linker script fragment for Ada GNAT sections
 *
 * This file handles GNAT-specific sections that are not defined in the
 * default Zephyr linker scripts.
 */

/*
 * .GPR.linker_options section
 *
 * Generated by GNAT binder (gnatbind) when processing pragma Linker_Options.
 * Contains linker options embedded in the object files.
 * We discard this section as the options are already processed by the build system.
 */
/DISCARD/ :
{
    *(.GPR.linker_options)
}

/*
 * ISR (interrupt) stack bounds required by Ada's stack_trace_capture.adb.
 *
 * Zephyr defines _interrupt_stack (via K_KERNEL_STACK_DEFINE) as the MSP
 * stack used in exception/interrupt context.  The Ada runtime imports these
 * two symbols to determine whether a stack trace is being captured from
 * an ISR (MSP) or a task (PSP) context.
 *
 * CONFIG_ISR_STACK_SIZE is available here because Zephyr preprocesses
 * linker script fragments through the C preprocessor before linking.
 */
PROVIDE(__interrupt_stack_start = z_interrupt_stacks);
PROVIDE(__interrupt_stack_end   = z_interrupt_stacks + CONFIG_ISR_STACK_SIZE);
