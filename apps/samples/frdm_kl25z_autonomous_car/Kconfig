## apps/samples/frdm_kl25z_autonomous_car/Kconfig
```kconfig
# SPDX-License-Identifier: Apache-2.0

source "Kconfig.zephyr"
rsource "../../zephyr_ada_rts/Kconfig.ada"
```

## modules/lang/ada/samples/ada_protected_objects/sample.yaml
```yaml
sample:
  name: Ada Protected Objects Demo
  description: >
    Demonstrates Ada protected objects as the sole synchronization mechanism
    on Zephyr: a protected variable (mutex replacement), a bounded buffer with
    entry barriers (semaphore-like producer-consumer), and an event flag for
    ISR-to-task notification — all without any k_mutex, k_sem, or k_condvar
    calls in Ada code.

  tags:
    - ada
    - tasking
    - protected_objects

tests:
  sample.ada.protected_objects:
    build_only: false
    filter: CONFIG_ADA
    platform_allow:
      - frdm_kl25z
      - hifive1_revb
      - esp32c3_devkitm
      - qemu_cortex_m3
    integration_platforms:
      - qemu_cortex_m3
    harness: console
    harness_config:
      type: one_line
      regex:
        - "Ada Protected Objects Demo"
        - "Produced:"
```

## modules/lang/ada/samples/ada_tasking/sample.yaml
```yaml
sample:
  name: Ada Tasking Demo
  description: >
    Demonstrates Ada-native concurrency on Zephyr: named task types with
    different priorities, Ada delay statements (mapped to k_msleep), a
    producer/consumer mailbox via protected entries, and a shared protected
    counter — all without any Zephyr C API calls in Ada code.

  tags:
    - ada
    - tasking

tests:
  sample.ada.tasking:
    build_only: false
    filter: CONFIG_ADA
    platform_allow:
      - frdm_kl25z
      - hifive1_revb
      - esp32c3_devkitm
      - qemu_cortex_m3
    integration_platforms:
      - qemu_cortex_m3
    harness: console
    harness_config:
      type: one_line
      regex:
        - "Ada Tasking Demo started"
        - "Worker 1: iteration"
```

## modules/lang/ada/samples/hello_world/sample.yaml
```yaml
sample:
  name: Ada Hello World
  description: >
    Minimal Ada application running three concurrent tasks on Zephyr.
    Demonstrates Ada-first concurrency (no Zephyr C API in Ada code),
    Ada delay statements mapped to k_msleep, and Kconfig access via
    the generated Zephyr.Config Ada package.

  tags:
    - ada
    - tasking
    - hello_world

tests:
  sample.ada.hello_world:
    build_only: false
    filter: CONFIG_ADA
    platform_allow:
      - frdm_kl25z
      - hifive1_revb
      - esp32c3_devkitm
      - qemu_cortex_m3
    integration_platforms:
      - qemu_cortex_m3
    harness: console
    harness_config:
      type: one_line
      regex:
        - "Ada Hi task running"
        - "Ada Mid task running"
```
