## CMakeLists.txt
```
# SPDX-License-Identifier: Apache-2.0
#
# FRDM-KL25Z Autonomous Car - Zephyr Ada port
# Target: NXP KL25Z (ARM Cortex-M0+, 16 KB SRAM, 128 KB flash)

cmake_minimum_required(VERSION 3.20.0)

# zephyr-lang-ada is registered via west (west.yml → modules/lang/ada).
# ada_alire_application() is provided by that module.
find_package(Zephyr REQUIRED HINTS $ENV{ZEPHYR_BASE})
project(frdm_kl25z_autonomous_car)

# Point ada_alire_application() at the local zephyr_ada_rts clone.
# Remove this line once zephyr_ada_rts is published to alire-index and
# the module can infer the path from the Alire cache.
set(ADA_RTS_DIR "/home/josegrivera/my-projects/zephyr_ada_rts")

# The Ada application crate lives at the project root (no ada_app/ subdirectory).
# ada_alire_application() handles: Kconfig→Ada, DTS→Ada, alr build,
# the C entry shim (ada_appinit + ada_main), and RTS linking.
ada_alire_application(
  LIBNAME     libada_app
  ADA_APP_DIR ${CMAKE_CURRENT_SOURCE_DIR}
)

# Car-specific linker fragment: provides __interrupt_stack_start/_end symbols
# used by stack_trace_capture.adb.
zephyr_linker_sources(SECTIONS ada_sections.ld)

target_link_libraries(app PRIVATE libada_app)
```

## prj.conf
```kconfig
CONFIG_ASSERT=y
#CONFIG_HW_STACK_PROTECTION=y
CONFIG_SCHED_CPU_MASK=y
CONFIG_BOOT_BANNER=y
CONFIG_PRINTK=y

# Logging configuration:
CONFIG_LOG=y
#CONFIG_LOG_BACKEND_UART=y   # this is redundant with CONFIG_SHELL_BACKEND_SERIAL and CONFIG_PRINTK
#CONFIG_LOG_CMDS=y
#CONFIG_LOG_DEFAULT_LEVEL=4  # this makes zephyr crash on a data abort
#CONFIG_LOG_DEFAULT_LEVEL=3  # this is the default
#CONFIG_LOG_MAX_LEVEL=4	     # this is the default (LOG_DBGs compiled-in)
#CONFIG_LOG_MAX_LEVEL=3      # this is the default
CONFIG_LOG_MODE_IMMEDIATE=y  # without this command-line does not work correctly
#CONFIG_LOG_MODE_DEFERRED=y  # with this command-line does not work correctly
#CONFIG_LOG_SPEED=y
CONFIG_LOG_SIMPLE_MSG_OPTIMIZE=y

# Console configuration:
CONFIG_CONSOLE=y
CONFIG_EARLY_CONSOLE=y
CONFIG_UART_CONSOLE=y

# Debugging configuration:
CONFIG_DEBUG_COREDUMP=y
CONFIG_DEBUG_COREDUMP_BACKEND_LOGGING=y
#CONFIG_DEBUG_INFO=y
#CONFIG_EXCEPTION_STACK_TRACE=y
CONFIG_EXCEPTION_DEBUG=y
CONFIG_EXTRA_EXCEPTION_INFO=y
#CONFIG_GDBSTUB=y
#CONFIG_GDBSTUB_SERIAL_BACKEND=y

CONFIG_INIT_STACKS=y
CONFIG_THREAD_STACK_INFO=y
CONFIG_THREAD_MONITOR=y
CONFIG_THREAD_NAME=y
CONFIG_POSIX_API=y
#CONFIG_POSIX_AEP_CHOICE_PSE51=y
#CONFIG_POSIX_FD_MGMT=y
#CONFIG_POSIX_MESSAGE_PASSING=y
#CONFIG_POSIX_NETWORKING=y
CONFIG_DYNAMIC_THREAD=y
CONFIG_DYNAMIC_THREAD_POOL_SIZE=3
CONFIG_NUM_PREEMPT_PRIORITIES=32
#CONFIG_POSIX_THREAD_THREADS_MAX=3


# Stats configuration:
CONFIG_STATS=y
CONFIG_THREAD_RUNTIME_STATS=y
CONFIG_THREAD_RUNTIME_STATS_USE_TIMING_FUNCTIONS=y
```

## src/main.c
```c
/* main.c - Synchronization demo */

/*
 * Copyright (c) 2012-2014 Wind River Systems, Inc.
 *
 * SPDX-License-Identifier: Apache-2.0
 */

#include "ada_app.h"
#include <zephyr/kernel.h>
#include <zephyr/sys/printk.h>

int main(void)
{
	printk(CONFIG_BOARD_TARGET " firmware (built on " __DATE__ " " __TIME__ ")\n");
  ada_appinit();
  ada_main();
	return 0;
}
```

## src/ada_app.h
```c
/**
 * @file ada_app.h
 *
 * Ada app library interface to C code
 *
 * @author German Rivera
 */
#ifndef ADA_APP_H_
#define ADA_APP_H_

#if defined(__cplusplus)
extern "C"
{
#endif

/**
 * Ada secondary stack size in bytes
 */
#define ADA_SECONDARY_STACK_SIZE 1024u

void ada_appinit(void);

void ada_main(void);

#if defined(__cplusplus)
}
#endif

#endif /* ADA_APP_H_ */
```
